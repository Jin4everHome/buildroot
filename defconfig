## defconfig
```kconfig
BR2_arm=y
BR2_cortex_a17=y
BR2_ARM_FPU_NEON_VFPV4=y
BR2_TOOLCHAIN_EXTERNAL=y
BR2_TOOLCHAIN_EXTERNAL_LINARO_ARM=y
BR2_TOOLCHAIN_EXTERNAL_PREINSTALLED=y
BR2_TARGET_GENERIC_HOSTNAME="joveai-rk3288"
BR2_TARGET_GENERIC_ISSUE="Welcome to JoveAI RK3288"
BR2_ROOTFS_DEVICE_CREATION_DYNAMIC_EUDEV=y
BR2_PACKAGE_ROCKCHIP=y
BR2_PACKAGE_RK3288=y
BR2_PACKAGE_ROCKCHIP_RGA=y
# BR2_PREFER_ROCKCHIP_RGA is not set
BR2_PACKAGE_RK3288_MALI=y
BR2_PACKAGE_RK3288_MALI_DRM=y
BR2_PACKAGE_ROCKCHIP_MPP=y
BR2_PACKAGE_ROCKCHIP_MPP_ALLOCATOR_DRM=y
BR2_PACKAGE_ROCKCHIP_MPP_TESTS=y
BR2_PACKAGE_FFMPEG=y
BR2_PACKAGE_STRACE=y
BR2_PACKAGE_CIFS_UTILS=y
BR2_PACKAGE_E2FSPROGS=y
BR2_PACKAGE_E2FSPROGS_FUSE2FS=y
BR2_PACKAGE_E2FSPROGS_RESIZE2FS=y
BR2_PACKAGE_WESTON=y
BR2_PACKAGE_OPENSSL=y
BR2_PACKAGE_WAYLAND_UTILS=y
BR2_PACKAGE_LIBCURL=y
BR2_PACKAGE_LIBCURL_TLS_NONE=y
BR2_TARGET_ROOTFS_CPIO=y
BR2_TARGET_ROOTFS_CPIO_GZIP=y
BR2_TARGET_ROOTFS_CPIO_UIMAGE=y
BR2_TARGET_ROOTFS_CRAMFS=y
# BR2_TARGET_ROOTFS_TAR is not set
BR2_PACKAGE_HOST_DOSFSTOOLS=y
BR2_PACKAGE_HOST_E2FSPROGS=y
BR2_PACKAGE_HOST_GENIMAGE=y
BR2_PACKAGE_HOST_KMOD=y
BR2_PACKAGE_HOST_MTOOLS=y
BR2_PACKAGE_HOST_UBOOT_TOOLS_FIT_SUPPORT=y
BR2_PACKAGE_HOST_UBOOT_TOOLS_FIT_SIGNATURE_SUPPORT=y
```

## package/rockchip/Config.in
```kconfig
menuconfig BR2_PACKAGE_ROCKCHIP
	bool "Rockchip Platform"

if BR2_PACKAGE_ROCKCHIP

config BR2_PACKAGE_ROCKCHIP_HAS_ISP1
	bool
	help
	  Has Rockchip ISP1

config BR2_PACKAGE_ROCKCHIP_HAS_ISP2
	bool
	help
	  Has Rockchip ISP2

config BR2_PACKAGE_ROCKCHIP_HAS_ISP3
	bool
	help
	  Has Rockchip ISP3

choice
	default BR2_PACKAGE_RK3588
	prompt "Rockchip SoC"

config BR2_PACKAGE_PX30
	bool "px30 chip"
	select BR2_PACKAGE_ROCKCHIP_HAS_ISP1
	help
	  Use rockchip's px30 chip

config BR2_PACKAGE_RK3036
	bool "rk3036 chip"
	help
	  Use rockchip's rk3036 chip

config BR2_PACKAGE_RK312X
	bool "rk312x chip"
	select BR2_PACKAGE_ROCKCHIP_HAS_ISP1
	help
	  Use rockchip's rk312x chip

config BR2_PACKAGE_RK3288
	bool "rk3288 chip"
	select BR2_PACKAGE_ROCKCHIP_HAS_ISP1
	help
	  Use rockchip's rk3288 chip

config BR2_PACKAGE_RK3308
	bool "rk3308 chip"
	help
	  Use rockchip's rk3308 chip

config BR2_PACKAGE_RK3326
	bool "rk3326 chip"
	select BR2_PACKAGE_ROCKCHIP_HAS_ISP1
	help
	  Use rockchip's rk3326 chip

config BR2_PACKAGE_RK3358
	bool "rk3358 chip"
	select BR2_PACKAGE_ROCKCHIP_HAS_ISP1
	help
	  Use rockchip's rk3358 chip

config BR2_PACKAGE_RK3399
	bool "rk3399 chip"
	select BR2_PACKAGE_ROCKCHIP_HAS_ISP1
	help
	  Use Rockchip's rk3399 SoC

config BR2_PACKAGE_RK3399PRO
	bool "rk3399pro chip"
	select BR2_PACKAGE_ROCKCHIP_HAS_ISP1
	help
	  Use Rockchip's rk3399pro SoC

config BR2_PACKAGE_RK356X
	bool "rk356x chip"
	select BR2_PACKAGE_ROCKCHIP_HAS_ISP2
	help
	  Use Rockchip's rk356x SoC

config BR2_PACKAGE_RK3588
	bool "rk3588"
	select BR2_PACKAGE_ROCKCHIP_HAS_ISP3
	help
	  Use Rockchip's rk3588 SoC

endchoice

menu "Rockchip BSP packages"
	source "package/rockchip/libv4l-rkmpp/Config.in"
	source "package/rockchip/rockchip-rga/Config.in"
	source "package/rockchip/rk3288-mali/Config.in"
	source "package/rockchip/rockchip-mpp/Config.in"
endmenu


endif
```

## package/rockchip/rk3288-mali/Config.in
```kconfig
config BR2_PACKAGE_RK3288_MALI
	bool "rockchip-mali"
	depends on BR2_INSTALL_LIBSTDCPP
	depends on BR2_TOOLCHAIN_USES_GLIBC
	depends on BR2_TOOLCHAIN_HAS_THREADS
	depends on BR2_aarch64 || (BR2_ARM_EABIHF && BR2_arm)
	select BR2_PACKAGE_LIBDRM
	select BR2_PACKAGE_HAS_LIBEGL
	select BR2_PACKAGE_HAS_LIBEGL_WAYLAND
	select BR2_PACKAGE_HAS_LIBGLES
	help
	  Install the binary user-space components for the ARM Mali GPU.
	  This package requires a kernel with the ARM Mali GPU Kernel
	  Drivers enabled.


if BR2_PACKAGE_RK3288_MALI
choice
	prompt "backend"

config BR2_PACKAGE_RK3288_MALI_FBDEV
    bool "fbdev"

config BR2_PACKAGE_RK3288_MALI_DRM
    bool "drm"

endchoice

config BR2_PACKAGE_PROVIDES_LIBEGL
    default "rk3288-mali"

config BR2_PACKAGE_PROVIDES_LIBGLES
    default "rk3288-mali"

endif
```

## package/rockchip/rockchip-rga/Config.in
```kconfig
config BR2_PACKAGE_ROCKCHIP_RGA
	bool "rga"
	select BR2_PACKAGE_LIBDRM
	help
	  Rockchip RGA 2D accelerator userspace library.

if BR2_PACKAGE_ROCKCHIP_RGA
config BR2_PREFER_ROCKCHIP_RGA
	bool "prefer using rockchip-rga"
	# HACK: Use ISP3 to detect RGA3
	default y
	help
	  Prefer using rockchip-rga when available.
endif
```
